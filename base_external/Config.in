## base_external/Config.in
```kconfig
source "$BR2_EXTERNAL_project_base_PATH/package/industrial-data-acquisition-gateway/Config.in"
```

## base_external/configs/_qemu_defconfig
```kconfig
BR2_aarch64=y
BR2_KERNEL_HEADERS_7_0=y
BR2_LINUX_KERNEL=y
BR2_LINUX_KERNEL_USE_ARCH_DEFAULT_CONFIG=y
BR2_PACKAGE_DROPBEAR=y
BR2_PACKAGE_OPENSSH=y
BR2_TARGET_ROOTFS_EXT2=y
BR2_TARGET_ROOTFS_EXT2_4=y
BR2_PACKAGE_INDUSTRIAL-DATA-ACQUISITION-GATEWAY=y
```

## base_external/package/industrial-data-acquisition-gateway/Config.in
```kconfig
config BR2_PACKAGE_INDUSTRIAL_DATA_ACQUISITION_GATEWAY
	bool "industrial-data-acquisition-gateway"
	help
	  Includes the 4 daemon processes to acquire, process, log and transmit the sensor data.
```
